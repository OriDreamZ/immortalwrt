// SPDX-License-Identifier: GPL-2.0-or-later OR MIT

#include "mt7981b-h3c-magic-nx30-pro.dtsi"

/ {
	model = "H3C Magic NX30 Pro (112M UBI layout)";
	compatible = "h3c,magic-nx30-pro-112m", "mediatek,mt7981";
};

&spi_nand {
	mediatek,nmbm;
	mediatek,bmt-max-ratio = <1>;
	mediatek,bmt-max-reserved-blocks = <64>;
};

&ubi {
	reg = <0x0580000 0x7000000>;
};
